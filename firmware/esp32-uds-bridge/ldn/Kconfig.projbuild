## firmware/esp32-uds-bridge/ldn/Kconfig.projbuild
```kconfig
menu "LDN bridge"
config LDN_PROBE_CHANNEL
    int "Initial 2.4 GHz channel"
    range 1 11
    default 1
config LDN_PROBE_PRIVATE_JOIN
    bool
    default y
config LDN_PROBE_EXPORT_ADVERTISEMENTS
    bool
    default y
config LDN_PROBE_CONTROL_PORT
    bool
    default y
config LDN_PROBE_LEGACY_PHY
    bool "Use 802.11b/g for LDN compatibility"
    default y
config PICO_LINK_TX_GPIO
    int "GPIO wired to the GB-Link's GP9 (its UART RX)"
    default 2
config PICO_LINK_RX_GPIO
    int "GPIO wired to the GB-Link's GP8 (its UART TX)"
    default 1
config PIA_STATIC_ZSTD_CONTEXT
    bool "Reserve the decompression context at link time"
    default y
    help
        40 KB of static data. Turn it off on a chip whose static data region is too small
        (the original ESP32); the context then comes from the heap at the start of boot.
config PIA_ZSTD_LITERAL_BUFFER
    int "Decompression literal buffer, in bytes"
    range 1024 65536
    default 8192
    help
        Part of the decompression context, used only for literals that do not fit in
        the destination. Pia's bodies are small enough that the 1 KB minimum works; each
        KB less is a KB more heap.
config BRIDGE_USB_RX_BUFFER
    int "USB console receive buffer, in bytes"
    default 32768
    help
        Heap for data from the web client or PC until the bridge reads it. The driver
        drops what does not fit, so a smaller buffer only suits a board whose host sends
        little at a time (the web client).
config BRIDGE_USB_TX_BUFFER
    int "USB console send buffer, in bytes"
    default 8192
config BRIDGE_WIFI_MAX_TX_POWER
    int "Wi-Fi transmit power cap, in 0.25 dBm steps (0: the chip's own maximum)"
    range 0 84
    default 0
    help
        Some ESP32-C3 boards (the C3 SuperMini among them) send garbled frames at full
        power: they hear the Switch's room but their join is never answered. The Switch
        sits within a metre or two, so a low cap costs nothing.
config BRIDGE_HOST_MAX_TX_POWER
    int "Wi-Fi transmit power cap while hosting a room, in 0.25 dBm steps (0: none)"
    range 0 84
    default 60
    help
        Hosting sends the room's long advertisements ten times a second at the slowest
        rate, so the radio draws its peak current for much longer than when joining a
        room. On boards with a weak supply that dips the voltage until the brownout
        detector resets the chip. The Switch sits within a metre or two, so 15 dBm is
        plenty.
endmenu
```

## firmware/esp32-uds-bridge/main/Kconfig.projbuild
```kconfig
menu "UDS bridge"

config UDS_LINK_PORT
    bool "Game Boy link port wired to GPIOs (no GB-Link)"
    default n
    help
        A GBA/GBC/Game Boy link port wired to this board through a level shifter, with no GB-Link: the board clocks the cartridge
        itself, as the GB-Link's Pico would. With no host on USB and the 3DS key stored, the board runs the Game Boy wrapper on its
        own; a host's HELLO takes the board back, and mGBA's uds-gblink-relay --port starts it with the log on the PC. The defaults
        are the shared VC-Adapter / GB-Link pinout on a Seeed XIAO ESP32-S3: SC on D0, SI on D1, SO on D2, SD on D3. SI and SO are
        named from this board's side, as on the GB-Link: this board's SI takes the console's SO, its SO feeds the console's SI. See
        the README's "GBA link port".

config UDS_LINK_PORT_SC_GPIO
    int "GPIO for SC, the clock (port pin 5)"
    depends on UDS_LINK_PORT
    default 1

config UDS_LINK_PORT_SI_GPIO
    int "GPIO for SI, this board's serial in (from the console's SO, port pin 2)"
    depends on UDS_LINK_PORT
    default 2

config UDS_LINK_PORT_SO_GPIO
    int "GPIO for SO, this board's serial out (to the console's SI, port pin 3)"
    depends on UDS_LINK_PORT
    default 3

config UDS_LINK_PORT_SD_GPIO
    int "GPIO for SD (port pin 4), -1 for none"
    depends on UDS_LINK_PORT
    range -1 48
    default 4
    help
        Wired for the shared pinout, unused in a Game Boy's link (only GBA multiplayer uses SD): the pin is held as an input with no
        pull, so it never drives the line.

config UDS_LINK_PORT_SENSE_GPIO
    int "ADC1 GPIO reading the port's VCC (pin 1) through a 1:2 divider, -1 for none"
    depends on UDS_LINK_PORT
    range -1 48
    default -1
    help
        Two equal resistors (100k each) from the port's VCC to GND, their middle to this pin (an ADC1 pin: GPIO1 to GPIO10 on the
        ESP32-S3; the XIAO's D4 is GPIO5). With it the board knows whether a console is on the port and in GB/GBC mode (5 V) or
        running a GBA game (3.3 V): it starts on its own only for a Game Boy, and stops when the console goes off. Without it the
        board assumes a Game Boy is there.

config UDS_LINK_PORT_CLOCK_HZ
    int "Link clock while a byte goes out, in Hz"
    depends on UDS_LINK_PORT
    range 8192 1000000
    default 262144
    help
        How fast the 8 bits of each byte are clocked (how often bytes go is the pacing below). 262144 is a Game Boy Color's fast serial
        clock, well inside what a Game Boy takes as a slave, and makes a byte about 31 us. The GB-Link's Pico clocks at about 1 MHz.
        8192, a Game Boy's own clock, makes a byte a millisecond: long enough that a cartridge re-arming its serial port in the
        middle of one loses its place (the first hardware run, firmware 1.8 before this setting).

config UDS_LINK_PORT_PACE_US
    int "Extra wait after each byte while roles are chosen and data is exchanged, in microseconds"
    depends on UDS_LINK_PORT
    range 0 20000
    default 2500
    help
        The gaps between bytes were measured with a GB-Link, where each byte also made a round trip through a PC (about 2.5 ms): the
        cartridge got about 3 ms between bytes, and trades worked. The link port has no round trip, so this stands in for it, keeping
        the gaps a cartridge has been seen to keep up with. The idle, sync and menu loops keep their 12.6 ms period either way.

endmenu
```
