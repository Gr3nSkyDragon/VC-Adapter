## firmware/esp32-uds-bridge/ldn/Kconfig.projbuild
```kconfig
menu "LDN bridge"
config LDN_PROBE_CHANNEL
    int "Initial 2.4 GHz channel"
    range 1 11
    default 1
config LDN_PROBE_PRIVATE_JOIN
    bool
    default y
config LDN_PROBE_EXPORT_ADVERTISEMENTS
    bool
    default y
config LDN_PROBE_CONTROL_PORT
    bool
    default y
config LDN_PROBE_LEGACY_PHY
    bool "Use 802.11b/g for LDN compatibility"
    default y
config PICO_LINK_TX_GPIO
    int "GPIO wired to the GB-Link's GP9 (its UART RX)"
    default 2
config PICO_LINK_RX_GPIO
    int "GPIO wired to the GB-Link's GP8 (its UART TX)"
    default 1
config PIA_STATIC_ZSTD_CONTEXT
    bool "Reserve the decompression context at link time"
    default y
    help
        40 KB of static data. Turn it off on a chip whose static data region is too small
        (the original ESP32); the context then comes from the heap at the start of boot.
config PIA_ZSTD_LITERAL_BUFFER
    int "Decompression literal buffer, in bytes"
    range 1024 65536
    default 8192
    help
        Part of the decompression context, used only for literals that do not fit in
        the destination. Pia's bodies are small enough that the 1 KB minimum works; each
        KB less is a KB more heap.
config BRIDGE_USB_RX_BUFFER
    int "USB console receive buffer, in bytes"
    default 32768
    help
        Heap for data from the web client or PC until the bridge reads it. The driver
        drops what does not fit, so a smaller buffer only suits a board whose host sends
        little at a time (the web client).
config BRIDGE_USB_TX_BUFFER
    int "USB console send buffer, in bytes"
    default 8192
config BRIDGE_WIFI_MAX_TX_POWER
    int "Wi-Fi transmit power cap, in 0.25 dBm steps (0: the chip's own maximum)"
    range 0 84
    default 0
    help
        Some ESP32-C3 boards (the C3 SuperMini among them) send garbled frames at full
        power: they hear the Switch's room but their join is never answered. The Switch
        sits within a metre or two, so a low cap costs nothing.
config BRIDGE_HOST_MAX_TX_POWER
    int "Wi-Fi transmit power cap while hosting a room, in 0.25 dBm steps (0: none)"
    range 0 84
    default 60
    help
        Hosting sends the room's long advertisements ten times a second at the slowest
        rate, so the radio draws its peak current for much longer than when joining a
        room. On boards with a weak supply that dips the voltage until the brownout
        detector resets the chip. The Switch sits within a metre or two, so 15 dBm is
        plenty.
config BRIDGE_GBA_VCC_GPIO
    int "GPIO sensing the link port's pin 1 through a divider (-1: none)"
    range -1 48
    default -1
    help
        Pin 1 of the GBA's link port is 3.3 V while a GBA game runs and 5 V with a Game Boy
        or Game Boy Color cartridge. Wired through a divider to a GPIO with an ADC input, the
        bridge prints LDN_GBA_VCC at boot and whenever pin 1 changes between off, 3.3 V and
        5 V. On the original ESP32 use an ADC1 pin (GPIO 32-39): ADC2 does not work while
        Wi-Fi runs.
config BRIDGE_GBA_VCC_DIVIDER
    int "Pin 1 voltage per volt at the GPIO, in thousandths"
    range 1000 20000
    default 2000
    help
        2000 for two equal resistors, such as 10 kilohm from pin 1 to the GPIO and 10 kilohm
        from the GPIO to GND.
endmenu
```

## firmware/esp32-uds-bridge/main/Kconfig.projbuild
```kconfig
menu "UDS bridge"

config UDS_SWITCH_LDN
    bool "Switch side: GB-Link Switch LDN (needs ESP-IDF 6.1)"
    depends on !IDF_TARGET_ESP32S2
    default y
    help
        GB-Link Switch LDN's bridge (ldn/), with the board switching between it and the 3DS side by what the host speaks. Its GBA
        side drives a GB-Link Pico (on the UART, or through a host), so the ldn line has it. On the VC-Adapter board (the aio line) the
        wireless adapter is emulated on the link port pins instead (UDS_RFU_ADAPTER). The uds line turns it off (sdkconfig.uds: its
        hosts only speak 3DS, so the board never has to restart into the other mode). Ignored with ESP-IDF 5.x, which cannot build it.

config UDS_FIRMWARE_MAJOR
    int
    default 2

config UDS_FIRMWARE_MINOR
    int
    default 1
    help
        The firmware's version, <major>.<minor>, which HELLO_ACK reports. Every line is 2.1 (2.0 had two: its uds line, now the ldn
        line, and aio; 1.8 and 1.9 before them). HELLO_ACK's features tell them apart: the link-port bit marks aio, the no-Switch bit
        marks uds, and neither marks ldn. aio has had the Switch side since 2.1 (the emulated adapter), so it no longer sets the
        no-Switch bit.

config UDS_FIRMWARE_LINE
    string
    default "aio" if UDS_LINK_PORT
    default "ldn" if UDS_SWITCH_LDN
    default "uds"
    help
        Which firmware this is, in its name and app version (2.1-uds, 2.1-ldn, 2.1-aio): "uds", the 3DS side alone for a board on a
        computer (sdkconfig.uds: Azahar, PokeUDS); "ldn", the 3DS side and GB-Link Switch LDN's Switch side, switching by what the
        host speaks (sdkconfig.defaults: mGBA-LDN; 2.0 called it uds); or "aio", the standalone VC-Adapter board for the GB/GBA
        games (sdkconfig.aio: link port; the 3DS side for Game Boy games, the Switch side for GBA games through the emulated Wireless
        Adapter).

menu "Memory (per chip)"

config UDS_WIFI_STATIC_RX_BUFFERS
    int "3DS side: Wi-Fi static receive buffers"
    range 2 32
    default 10 if IDF_TARGET_ESP32S2
    default 4 if IDF_TARGET_ESP32 || IDF_TARGET_ESP32C3
    default 16
    help
        The 3DS side starts Wi-Fi with its own buffer counts (radio.c, init_wifi_once). 16/64/64 is what the S3 has always used; the
        classic ESP32 and the C3 get GB-Link Switch LDN's 4/16/16 for those chips, which has never been measured with a 3DS.

config UDS_WIFI_DYNAMIC_RX_BUFFERS
    int "3DS side: Wi-Fi dynamic receive buffers"
    range 4 128
    default 32 if IDF_TARGET_ESP32S2
    default 16 if IDF_TARGET_ESP32 || IDF_TARGET_ESP32C3
    default 64

config UDS_WIFI_DYNAMIC_TX_BUFFERS
    int "3DS side: Wi-Fi dynamic transmit buffers"
    range 4 128
    default 32 if IDF_TARGET_ESP32S2
    default 16 if IDF_TARGET_ESP32 || IDF_TARGET_ESP32C3
    default 64

config UDS_EVENT_RING_BYTES
    int "3DS side: ring for received frames on their way to the host, in bytes"
    range 8192 131072
    default 24576 if IDF_TARGET_ESP32S2
    default 16384 if IDF_TARGET_ESP32 || IDF_TARGET_ESP32C3
    default 49152

config UDS_HOST_RX_BUFFER
    int "3DS side: host link receive buffer, in bytes"
    range 1024 65536
    default 4096 if IDF_TARGET_ESP32
    default 8192 if IDF_TARGET_ESP32C3
    default 16384

config UDS_HOST_TX_BUFFER
    int "3DS side: host link send buffer, in bytes"
    range 1024 65536
    default 8192 if IDF_TARGET_ESP32
    default 4096 if IDF_TARGET_ESP32C3
    default 16384

endmenu

config UDS_BOARD_XIAO_C6_RF_SWITCH
    bool "Seeed XIAO ESP32-C6: turn its RF switch on (GPIO3 low) and pick the onboard antenna (GPIO14 low)"
    depends on IDF_TARGET_ESP32C6
    default y
    help
        The XIAO ESP32-C6's antenna switch is off until GPIO3 is driven low, and GPIO14 picks the antenna (low: onboard, high: U.FL).
        With both floating the radio only reaches strong nearby signals. Done before Wi-Fi starts, in both modes, as GB-Link Switch
        LDN's firmware/ESP32-C6 does. Turn it off on a C6 board that uses these pins for something else.

config UDS_LINK_PORT
    bool "Game Boy link port wired to GPIOs (no GB-Link)"
    depends on IDF_TARGET_ESP32S3
    default n
    help
        A GBA/GBC/Game Boy link port wired to this board through a level shifter, with no GB-Link: the board clocks the cartridge
        itself, as the GB-Link's Pico would. With no host on USB and the 3DS key stored, the board runs the Game Boy wrapper on its
        own; a host's HELLO takes the board back, and mGBA's uds-gblink-relay --port starts it with the log on the PC. The defaults
        are the shared VC-Adapter / GB-Link pinout on a Seeed XIAO ESP32-S3: SC on D0, SI on D1, SO on D2, SD on D3. SI and SO are
        named from this board's side, as on the GB-Link: this board's SI takes the console's SO, its SO feeds the console's SI. See
        the README's "GBA link port". ESP32-S3 only: the VC-Adapter board is S3 hardware, and these pins clash on the other chips
        (UART0 on the classic ESP32's GPIO1 and GPIO3, the XIAO C6's RF switch on GPIO3).

config UDS_RFU_ADAPTER
    bool "Switch side: the GBA Wireless Adapter emulated on the link port (no GB-Link)"
    depends on UDS_LINK_PORT && UDS_SWITCH_LDN
    default y
    help
        The Switch side's GBA end on this board's own link port pins, with no GB-Link: the wireless adapter a GBA game sees is
        GBLink-Firmware's emulation (rfu/), run here instead of on the Pico, and pico_link hands the bridge's frames to it in
        place of its UART. The GBA's 2 MHz serial clock is followed in software, so while the adapter is on the second core does
        nothing else, with interrupts masked (no interrupt watchdog check on that core). The console's link port must be in GBA
        mode (3.3 V).

config UDS_RFU_CABLE
    bool "Switch side: Ruby and Sapphire on the link cable (RFU Cable Wrapper, in progress)"
    depends on UDS_RFU_ADAPTER
    default y
    help
        Ruby and Sapphire have only the link cable. With this, the board is to be their cable partner and carry the link to
        the Switch's FireRed trade room as an FRLG child, as mGBA's RFU Cable Wrapper does (cable/: its wireless side,
        rfu-wrapper-air.c, unchanged). In progress: the wireless side builds and passes its PC test, but the cable master and
        the choice between the adapter and the cable are not written yet, so nothing runs it.

config UDS_RFU_KEEP_ADAPTER
    bool "Adapter: keep it up when the Switch side's session ends (restart the bridge in place)"
    depends on UDS_RFU_ADAPTER
    default y
    help
        GB-Link Switch LDN restarts the board after every session and failed join, and resets the adapter when a session ends;
        with a GB-Link the Pico keeps answering the GBA meanwhile. Here the adapter is on this chip, so that would take it off the
        GBA's link, and a GBA waiting on it for an event (as while it leaves the trade room) would wait for good. With this on,
        the bridge stops and starts its room search again in place instead, the adapter keeps running, and a session's end
        reaches the GBA as its partner disconnecting. Off: the board restarts as GB-Link Switch LDN does.

config UDS_RFU_STATUS_LED_GPIO
    int "Status LED for the emulated adapter, active low (-1 for none)"
    depends on UDS_RFU_ADAPTER
    default 21
    help
        The Seeed XIAO ESP32-S3's user LED (GPIO21) by default. Off: the adapter is off. A blip every two seconds: waiting for the
        GBA. Slow blink: the GBA clocks it, but no ID word gets through. Fast blink: the ID exchange is under way. On: the GBA found
        the adapter; it goes off for a moment every second while the Switch side is sending.

config UDS_RFU_GLUE_IRAM
    bool "Adapter: the link loop and its helpers in IRAM"
    depends on UDS_RFU_ADAPTER
    default y

config UDS_RFU_CORE_IRAM
    bool "Adapter: the protocol core's command, frame and timer code in IRAM"
    depends on UDS_RFU_ADAPTER
    default y

config UDS_RFU_MIN_HOLD_US
    int "Adapter: least time the GBA is held after a command word, in microseconds (0: none)"
    depends on UDS_RFU_ADAPTER
    default 0

config UDS_LINK_PORT_SC_GPIO
    int "GPIO for SC, the clock (port pin 5)"
    depends on UDS_LINK_PORT
    default 1

config UDS_LINK_PORT_SI_GPIO
    int "GPIO for SI, this board's serial in (from the console's SO, port pin 2)"
    depends on UDS_LINK_PORT
    default 2

config UDS_LINK_PORT_SO_GPIO
    int "GPIO for SO, this board's serial out (to the console's SI, port pin 3)"
    depends on UDS_LINK_PORT
    default 3

config UDS_LINK_PORT_SD_GPIO
    int "GPIO for SD (port pin 4), -1 for none"
    depends on UDS_LINK_PORT
    range -1 48
    default 4
    help
        Wired for the shared pinout, unused in a Game Boy's link (only GBA multiplayer uses SD): the pin is held as an input with no
        pull, so it never drives the line.

config UDS_LINK_PORT_SENSE_GPIO
    int "ADC1 GPIO reading the port's VCC (pin 1) through a 1:2 divider, -1 for none"
    depends on UDS_LINK_PORT
    range -1 48
    default -1
    help
        Two equal resistors (100k each) from the port's VCC to GND, their middle to this pin (an ADC1 pin: GPIO1 to GPIO10 on the
        ESP32-S3; the XIAO's D4 is GPIO5). With it the board knows whether a console is on the port and in GB/GBC mode (5 V) or
        running a GBA game (3.3 V): it starts on its own only for a Game Boy, and stops when the console goes off. Without it the
        board assumes a Game Boy is there.

config UDS_LINK_PORT_CLOCK_HZ
    int "Link clock while a byte goes out, in Hz"
    depends on UDS_LINK_PORT
    range 8192 1000000
    default 262144
    help
        How fast the 8 bits of each byte are clocked (how often bytes go is the pacing below). 262144 is a Game Boy Color's fast serial
        clock, well inside what a Game Boy takes as a slave, and makes a byte about 31 us. The GB-Link's Pico clocks at about 1 MHz.
        8192, a Game Boy's own clock, makes a byte a millisecond: long enough that a cartridge re-arming its serial port in the
        middle of one loses its place (the link port's first hardware run, before this setting).

config UDS_LINK_PORT_PACE_US
    int "Extra wait after each byte while roles are chosen and data is exchanged, in microseconds"
    depends on UDS_LINK_PORT
    range 0 20000
    default 2500
    help
        The gaps between bytes were measured with a GB-Link, where each byte also made a round trip through a PC (about 2.5 ms): the
        cartridge got about 3 ms between bytes, and trades worked. The link port has no round trip, so this stands in for it, keeping
        the gaps a cartridge has been seen to keep up with. The idle, sync and menu loops keep their 12.6 ms period either way.

endmenu

# GB-Link Switch LDN's options (the Switch side, ldn/). Its zstd component reads PIA_ZSTD_LITERAL_BUFFER from here.
rsource "../ldn/Kconfig.projbuild"
```
